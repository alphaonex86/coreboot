## src/cpu/amd/Kconfig
```kconfig
## SPDX-License-Identifier: GPL-2.0-only

source "src/cpu/amd/socket_a/Kconfig"
source "src/cpu/amd/model_7xx/Kconfig"
source "src/cpu/amd/pi/Kconfig"
```

## src/cpu/amd/model_7xx/Kconfig
```kconfig
## SPDX-License-Identifier: GPL-2.0-only

config CPU_AMD_MODEL_7XX
	bool
	select ARCH_X86
```

## src/cpu/amd/socket_a/Kconfig
```kconfig
## SPDX-License-Identifier: GPL-2.0-only

config CPU_AMD_SOCKET_A
	bool
	select CPU_AMD_MODEL_7XX
	select NO_SMM
	select UDELAY_TSC
	select TSC_MONOTONIC_TIMER
	select UNKNOWN_TSC_RATE
	select ARCH_X86

if CPU_AMD_SOCKET_A

config DCACHE_RAM_BASE
	hex
	default 0xc8000

config DCACHE_RAM_SIZE
	hex
	default 0x08000

config PRERAM_CBFS_CACHE_SIZE
	default 0x0

config DCACHE_BSP_STACK_SIZE
	hex
	default 0x1000

config C_ENV_BOOTBLOCK_SIZE
	hex
	default 0x10000

endif
```

## src/cpu/intel/model_5xx/Kconfig
```kconfig
## SPDX-License-Identifier: GPL-2.0-only

config CPU_INTEL_MODEL_5XX
	bool
	select ARCH_X86
```

## src/mainboard/ibm/aptiva2168/Kconfig
```kconfig
## SPDX-License-Identifier: GPL-2.0-only

if BOARD_IBM_APTIVA2168

config BOARD_SPECIFIC_OPTIONS
	def_bool y
	select CPU_486
	select BOARD_ROMSIZE_KB_128
	select MISSING_BOARD_RESET
	select NORTHBRIDGE_OPTI_VIPERM
	select SOUTHBRIDGE_OPTI_82C558M
	select SUPERIO_SMSC_SMSCSUPERIO
	select NO_MONOTONIC_TIMER
	select HAVE_PIRQ_TABLE
	select PIRQ_ROUTE

config MAINBOARD_DIR
	default "ibm/aptiva2168"

config MAINBOARD_PART_NUMBER
	default "Aptiva 2168"

config IRQ_SLOT_COUNT
	int
	default 3

endif # BOARD_IBM_APTIVA2168
```

## src/mainboard/pcchips/m756lmrt_plus/Kconfig
```kconfig
## SPDX-License-Identifier: GPL-2.0-only

if BOARD_PCCHIPS_M756LMRT_PLUS

config BOARD_SPECIFIC_OPTIONS
	def_bool y
	select NORTHBRIDGE_SIS_SIS630
	select SOUTHBRIDGE_SIS_SIS85C503
	select SUPERIO_ITE_IT8705F
	select CPU_INTEL_SLOT_1
	select HAVE_PIRQ_TABLE
	select BOARD_ROMSIZE_KB_256
	select MISSING_BOARD_RESET

config MAINBOARD_DIR
	default "pcchips/m756lmrt_plus"

config MAINBOARD_PART_NUMBER
	default "M756LMRT+"

config IRQ_SLOT_COUNT
	int
	default 5

config DCACHE_RAM_SIZE
	hex
	default 0x08000

config VGA_BIOS_FILE
	string
	default "src/mainboard/pcchips/m756lmrt_plus/sis630_vgabios.bin" if VGA_BIOS

config VGA_BIOS_ID
	string
	default "1039,6300" if VGA_BIOS

endif # BOARD_PCCHIPS_M756LMRT_PLUS
```

## src/mainboard/pcchips/m756lmrt_plus/Kconfig.name
```kconfig
## SPDX-License-Identifier: GPL-2.0-only

config BOARD_PCCHIPS_M756LMRT_PLUS
	bool "M756LMRT+"
	help
	  PCChips M756LMRT+ V5.3 mainboard with SiS 630 chipset,
	  Slot-1 + Socket 370 combo, ITE IT8705AF Super I/O.
```

## src/mainboard/pcchips/m758lmr_plus/Kconfig
```kconfig
## SPDX-License-Identifier: GPL-2.0-only

if BOARD_PCCHIPS_M758LMR_PLUS

config BOARD_SPECIFIC_OPTIONS
	def_bool y
	select NORTHBRIDGE_SIS_SIS630
	select SOUTHBRIDGE_SIS_SIS85C503
	select SUPERIO_SIS_SIS950
	select CPU_INTEL_SLOT_1
	select HAVE_PIRQ_TABLE
	select BOARD_ROMSIZE_KB_1024
	select MISSING_BOARD_RESET

config MAINBOARD_DIR
	default "pcchips/m758lmr_plus"

config MAINBOARD_PART_NUMBER
	default "M758LMR+"

config IRQ_SLOT_COUNT
	int
	default 5

config DCACHE_RAM_SIZE
	hex
	default 0x08000

endif # BOARD_PCCHIPS_M758LMR_PLUS
```

## src/mainboard/pcchips/m758lmr_plus/Kconfig.name
```kconfig
## SPDX-License-Identifier: GPL-2.0-only

config BOARD_PCCHIPS_M758LMR_PLUS
	bool "M758LMR+"
	help
	  PCChips M758LMR+ mainboard with SIS 630 chipset, Socket 370.
```

## src/mainboard/pcchips/m810lmr/Kconfig
```kconfig
## SPDX-License-Identifier: GPL-2.0-only

if BOARD_PCCHIPS_M810LMR

config BOARD_SPECIFIC_OPTIONS
	def_bool y
	select NORTHBRIDGE_SIS_SIS730
	select SOUTHBRIDGE_SIS_SIS85C503
	select SUPERIO_SIS_SIS950
	select CPU_AMD_SOCKET_A
	select CPU_INTEL_SLOT_1
	select HAVE_PIRQ_TABLE
	select BOARD_ROMSIZE_KB_1024
	select MISSING_BOARD_RESET

config MAINBOARD_DIR
	default "pcchips/m810lmr"

config MAINBOARD_PART_NUMBER
	default "M810LMR"

config IRQ_SLOT_COUNT
	int
	default 4

config DCACHE_RAM_SIZE
	hex
	default 0x08000

endif # BOARD_PCCHIPS_M810LMR
```

## src/mainboard/pcchips/m810lmr/Kconfig.name
```kconfig
## SPDX-License-Identifier: GPL-2.0-only

config BOARD_PCCHIPS_M810LMR
	bool "M810LMR"
	help
	  PCChips M810LMR mainboard with SIS 730 chipset, Socket A.
```

## src/mainboard/pcchips/m830lr/Kconfig
```kconfig
## SPDX-License-Identifier: GPL-2.0-only

if BOARD_PCCHIPS_M830LR

config BOARD_SPECIFIC_OPTIONS
	def_bool y
	select NORTHBRIDGE_SIS_SIS735
	select SOUTHBRIDGE_SIS_SIS85C503
	select SUPERIO_SIS_SIS950
	select CPU_AMD_SOCKET_A
	select HAVE_PIRQ_TABLE
	select BOARD_ROMSIZE_KB_1024
	select MISSING_BOARD_RESET

config MAINBOARD_DIR
	default "pcchips/m830lr"

config MAINBOARD_PART_NUMBER
	default "M830LR"

config IRQ_SLOT_COUNT
	int
	default 8

config DCACHE_RAM_SIZE
	hex
	default 0x08000

endif # BOARD_PCCHIPS_M830LR
```

## src/mainboard/pcchips/m830lr/Kconfig.name
```kconfig
## SPDX-License-Identifier: GPL-2.0-only

config BOARD_PCCHIPS_M830LR
	bool "M830LR"
	help
	  PCChips M830LR mainboard with SIS 735 chipset, Socket A, DDR SDRAM.
```

## src/northbridge/opti/viperm/Kconfig
```kconfig
# SPDX-License-Identifier: GPL-2.0-only

config NORTHBRIDGE_OPTI_VIPERM
	bool
	select NO_ECAM_MMCONF_SUPPORT
	select NO_CBFS_MCACHE
	select NO_DDR5
	select NO_LPDDR4
	select NO_DDR4
	select NO_DDR3
	select NO_DDR2
	select NO_SMM
	select BOOT_DEVICE_NOT_SPI_FLASH
	select NO_FMAP_CACHE
```

## src/northbridge/sis/sis735/Kconfig
```kconfig
## SPDX-License-Identifier: GPL-2.0-only

config NORTHBRIDGE_SIS_SIS735
	bool
	select BOOT_DEVICE_NOT_SPI_FLASH
	select HAVE_DEBUG_RAM_SETUP
	select NO_ECAM_MMCONF_SUPPORT
```

## src/southbridge/opti/82c558m/Kconfig
```kconfig
# SPDX-License-Identifier: GPL-2.0-only

config SOUTHBRIDGE_OPTI_82C558M
	bool
	select BOOT_DEVICE_NOT_SPI_FLASH
```

## src/southbridge/sis/sis85c503/Kconfig
```kconfig
## SPDX-License-Identifier: GPL-2.0-only

config SOUTHBRIDGE_SIS_SIS85C503
	bool
	select HAVE_PIRQ_TABLE
```
